## drivers/nfc/Kconfig
```kconfig
#
# Near Field Communication (NFC) devices
#

menu "Near Field Communication (NFC) devices"

config LGE_NFC
	bool "NFC Device Enabled for LGE"
	default n

config PN544_NFC
	tristate "PN544 NFC driver"
	depends on I2C
	select CRC_CCITT
	default n
	---help---
	  Say yes if you want PN544 Near Field Communication driver.
	  This is for i2c connected version. If unsure, say N here.

	  To compile this driver as a module, choose m here. The module will
	  be called pn544.

config NFC_PN533
	tristate "NXP PN533 USB driver"
	depends on USB
	help
	  NXP PN533 USB driver.
	  This driver provides support for NFC NXP PN533 devices.

	  Say Y here to compile support for PN533 devices into the
	  kernel or say M to compile it as module (pn533).

config NFC_WILINK
	tristate "Texas Instruments NFC WiLink driver"
	depends on TI_ST && NFC_NCI
	help
	  This enables the NFC driver for Texas Instrument's BT/FM/GPS/NFC
	  combo devices. This makes use of shared transport line discipline
	  core driver to communicate with the NFC core of the combo chip.

	  Say Y here to compile support for Texas Instrument's NFC WiLink driver
	  into the kernel or say M to compile it as module.

config NFC_BCM2079X
	bool "Broadcom 2079X NFC Controller Driver"
	depends on I2C
	select CRC_CCITT
	help
	  Broadcom 2079X Near Field Communication controller support.

endmenu

config LGE_NFC_USE_PMIC
	bool "NFC Using PMIC Clock"
	depends on LGE_NFC
	default n
	---help---
	  Say yes if you want to use PMIC Clock.
	  If use XTAL or unsure, say N here.
	  Please refer to [NFC-367] for more details.

config NFC_QNCI
	bool "Qualcomm NCI based NFC Controller Driver for qca199x"
	depends on I2C
	select CRC_CCITT
	help
	  This enables the NFC driver for QCA199x based devices.
	  This is for i2c connected version. NCI protocol logic
	  resides in the usermode and it has no other NFC dependencies.
```
